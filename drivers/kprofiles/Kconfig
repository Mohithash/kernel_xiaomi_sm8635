## drivers/kprofiles/Kconfig
```kconfig
# SPDX-License-Identifier: GPL-2.0
#
# Copyright (C) 2021-2023 Dakkshesh <dakkshesh5@gmail.com>.

config KPROFILES
	tristate "Kprofiles Kernel Module"
	default y
	help
	  This allows you to regulate in-kernel activities in a profile-oriented manner.
	  It creates a sysfs node which can be used to change profiles via userspace.
	  It provides 4 profile modes: Disabled, Battery, Balanced and Performance.

	  The former can be used to disable/enable or tune kernel activities according
	  to a profile mode. Check the README.md for more information.

	  It's safe to say Y here, as the driver isn't very demanding and is only
	  used when developer uses the exported API functions in an another driver.

if KPROFILES

config KP_DEFAULT_MODE
	int "Default mode number for kp_mode"
	range 0 3
	default 0
	help
	  Kprofiles will activate this mode during boot-up.

config KP_VERBOSE_DEBUG
	bool "Verbose Kprofiles debugging"
	default n
	help
	  Say Y here if you are testing Kprofiles or trying to
	  debug and indentify problems.

endif # if KPROFILES
```

## drivers/thermal/xiaomi/Kconfig
```kconfig
# SPDX-License-Identifier: GPL-2.0-only
#
# Xiaomi thermal drivers configuration
#

config MI_THERMAL_INTERFACE
	tristate "xiaomi thermal control interface"
	depends on THERMAL
	default n
	help
	  This is xiaomi thermal control interface.

config MI_THERMAL_MULTI_CHARGE
	tristate "enable multi charge themral interface"
	help
	  Enable multi charge function in kernel, add two sysfs nodes in
	  thermal_message.

config MI_THERMAL_ATC_ENABLE
	tristate "enable atc enable themral interface"
	help
	  Enable atc enable function in kernel, add two sysfs nodes in
	  thermal_message.

config HAVE_MULTI_SCREEN
	bool "Have multi screen"
	default n
	help
		Enable register two screen in driver
```
